## boards/arm/96b_carbon/Kconfig.defconfig
```kconfig
# Kconfig - 96boards Carbon board configuration
#
# Copyright (c) 2016 Linaro Limited.
#
# SPDX-License-Identifier: Apache-2.0
#

if BOARD_96B_CARBON

config BOARD
	default 96b_carbon

if BLUETOOTH

config SPI
	default y

endif # BLUETOOTH

endif # BOARD_96B_CARBON
```

## boards/arm/96b_carbon_nrf51/96b_carbon_nrf51_defconfig
```kconfig
CONFIG_ARM=y
CONFIG_SOC_FAMILY_NRF5=y
CONFIG_SOC_SERIES_NRF51X=y
CONFIG_SOC_NRF51822_QFAC=y
CONFIG_BOARD_96B_CARBON_NRF51=y

# TODO: Disable console/uart
# enable uart driver
CONFIG_SERIAL=y
CONFIG_UART_NRF5=y
CONFIG_UART_NRF5_GPIO_TX_PIN=9
CONFIG_UART_NRF5_GPIO_RX_PIN=11

# enable console
CONFIG_CONSOLE=y
CONFIG_UART_CONSOLE=y

# bluetooth
CONFIG_BLUETOOTH=y
CONFIG_BLUETOOTH_CONTROLLER=y

# spi
CONFIG_SPI=y
CONFIG_SPI_SLAVE=y
CONFIG_SPI_0=y
CONFIG_SPI_0_NAME="SPI_0"
CONFIG_SPI_0_IRQ_PRI=1
CONFIG_SPI_NRF5=y
CONFIG_SPI_0_NRF5_GPIO_CS=25
CONFIG_SPI_0_NRF5_GPIO_SCK=7
CONFIG_SPI_0_NRF5_GPIO_MOSI=0
CONFIG_SPI_0_NRF5_GPIO_MISO=30
```

## boards/arm/96b_nitrogen/96b_nitrogen_defconfig
```kconfig
CONFIG_ARM=y
CONFIG_SOC_FAMILY_NRF5=y
CONFIG_SOC_SERIES_NRF52X=y
CONFIG_BOARD_96B_NITROGEN=y

# enable uart driver
CONFIG_SERIAL=y
CONFIG_UART_NRF5=y

# enable console
CONFIG_CONSOLE=y
CONFIG_UART_CONSOLE=y

# additional board options
CONFIG_GPIO_AS_PINRESET=y

# bluetooth
CONFIG_BLUETOOTH=y
CONFIG_BLUETOOTH_CONTROLLER=y

# spi
CONFIG_SPI=y
CONFIG_SPI_SLAVE=y
CONFIG_SPI_0=y
CONFIG_SPI_0_NAME="SPI_0"
CONFIG_SPI_0_IRQ_PRI=2
CONFIG_SPI_NRF5=y
CONFIG_SPI_0_NRF5_GPIO_CS=24
CONFIG_SPI_0_NRF5_GPIO_SCK=26
CONFIG_SPI_0_NRF5_GPIO_MOSI=23
CONFIG_SPI_0_NRF5_GPIO_MISO=25
```

## drivers/spi/Kconfig.nrf5
```kconfig
# Kconfig.nrf5 - nRF5X SPI driver configuration options
#
# Copyright (c) 2016 Linaro Limited.
#
# Licensed under the Apache License, Version 2.0 (the "License");
# you may not use this file except in compliance with the License.
# You may obtain a copy of the License at
#
#     http://www.apache.org/licenses/LICENSE-2.0
#
# Unless required by applicable law or agreed to in writing, software
# distributed under the License is distributed on an "AS IS" BASIS,
# WITHOUT WARRANTIES OR CONDITIONS OF ANY KIND, either express or implied.
# See the License for the specific language governing permissions and
# limitations under the License.
#

menuconfig SPI_NRF5
	bool "Nordic Semiconductor nRF5x SPI controller"
	depends on SPI && SOC_FAMILY_NRF5
	default n
	help
	  SPI driver implementation for the nRF51 and nRF52 series of SoCs from
	  Nordic Semiconductor.

if SPI_NRF5 && SPI_0

config SPI_0_NRF5_GPIO_CS
	int "GPIO number used as SPI Chip Select"
	depends on SPI_NRF5
	default 0
	help
	  There are 32 GPIO pins on the nRF5X SoCs. Range is between 0 and 31.

config SPI_0_NRF5_GPIO_SCK
	int "GPIO number used as SPI clock"
	depends on SPI_NRF5
	default 0
	help
	  There are 32 GPIO pins on the nRF5X SoCs. Range is between 0 and 31.

config SPI_0_NRF5_GPIO_MOSI
	int "GPIO number used as SPI MOSI line"
	depends on SPI_NRF5
	default 0
	help
	  There are 32 GPIO pins on the nRF5X SoCs. Range is between 0 and 31.

config SPI_0_NRF5_GPIO_MISO
	int "GPIO number used as SPI MISO line"
	depends on SPI_NRF5
	default 0
	help
	  There are 32 GPIO pins on the nRF5X SoCs. Range is between 0 and 31.

endif # SPI_NRF5
```
